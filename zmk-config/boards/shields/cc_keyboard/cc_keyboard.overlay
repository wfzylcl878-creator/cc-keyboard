/*
 * CC-Keyboard — 6 键直连扫描（SuperMini nRF52840）
 *
 * 引脚分配与 PCB 排针一一对应（见 ../README.md 接线表）：
 *   P0.06 = ESC    P0.08 = ↑      P0.17 = ←
 *   P0.20 = ↓      P0.22 = →      P0.24 = 回车
 * 每键一脚接 GPIO、另一脚接 GND，内部上拉、按下拉低。
 */

/ {
    kscan0: kscan {
        compatible = "zmk,kscan-gpio-direct";

        input-gpios
            = <&gpio0 6  (GPIO_ACTIVE_LOW | GPIO_PULL_UP)>   /* 1 ESC  */
            , <&gpio0 8  (GPIO_ACTIVE_LOW | GPIO_PULL_UP)>   /* 2 ↑    */
            , <&gpio0 17 (GPIO_ACTIVE_LOW | GPIO_PULL_UP)>   /* 3 ←    */
            , <&gpio0 20 (GPIO_ACTIVE_LOW | GPIO_PULL_UP)>   /* 4 ↓    */
            , <&gpio0 22 (GPIO_ACTIVE_LOW | GPIO_PULL_UP)>   /* 5 →    */
            , <&gpio0 24 (GPIO_ACTIVE_LOW | GPIO_PULL_UP)>   /* 6 ⏎    */
            ;

        debounce-period = <15>;
    };

    chosen {
        zmk,kscan = &kscan0;
    };
};
